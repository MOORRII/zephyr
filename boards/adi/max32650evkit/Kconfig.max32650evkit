## boards/adi/max32650evkit/Kconfig.max32650evkit
```kconfig
# MAX32650 board configuration

# Copyright (c) 2023-2024 Analog Devices, Inc.
# SPDX-License-Identifier: Apache-2.0

config BOARD_MAX32650EVKIT
	select SOC_MAX32650
```

## boards/adi/max32650evkit/board.yml
```yaml
# Copyright (c) 2023-2024 Analog Devices, Inc.
# SPDX-License-Identifier: Apache-2.0

board:
  name: max32650evkit
  vendor: adi
  socs:
    - name: max32650
```
